## fs/bcachefs/Config.in
```kconfig
config BR2_TARGET_ROOTFS_BCACHEFS
	bool "bcachefs root filesystem"
	select BR2_PACKAGE_HOST_BCACHEFS_TOOLS
	help
	  Build a bcachefs root filesystem. If you enable this option, you
	  probably want to enable the bcachefs-progs package too.

if BR2_TARGET_ROOTFS_BCACHEFS

config BR2_TARGET_ROOTFS_BCACHEFS_LABEL
	string "filesystem label"

config BR2_TARGET_ROOTFS_BCACHEFS_SIZE
	string "filesystem size"
	default "100m"
	help
	  The size of the filesystem image in bytes.

config BR2_TARGET_ROOTFS_BCACHEFS_SIZE_BLOCK
	string "block size"
	default "4096"
	help
	  Filesystem block size.

config BR2_TARGET_ROOTFS_BCACHEFS_SIZE_NODE
	string "btree node size"
	default "262144"
	help
	  Btree node size.

endif # BR2_TARGET_ROOTFS_BCACHEFS
```

## package/bcachefs-tools/Config.in.host
```kconfig
config BR2_PACKAGE_HOST_BCACHEFS_TOOLS
	bool "host bcachefs-tools"
	help
	  Bcachefs filesystem utilities

	  https://bcachefs.org/
```

## package/mlibc/Config.in
```kconfig
config BR2_PACKAGE_MLIBC_ARCH_SUPPORTS
	bool
	default y if BR2_aarch64
	default y if BR2_i386
	default y if BR2_RISCV_64
	default y if BR2_x86_64
	depends on BR2_USE_MMU

config BR2_PACKAGE_MLIBC_SUPPORTS
	bool
	default y if BR2_PACKAGE_MLIBC_ARCH_SUPPORTS

config BR2_PACKAGE_MLIBC
	bool
	default y
	depends on BR2_TOOLCHAIN_USES_MLIBC
	select BR2_PACKAGE_LINUX_HEADERS
	select BR2_TOOLCHAIN_HAS_SSP if BR2_PACKAGE_HOST_BINUTILS_SUPPORTS_CFI && !BR2_i386
	help
	  https://github.com/managarm/mlibc
```
